## src/gpio/driver/linux/Documentation/devicetree/bindings/gpio/gpio-oh.txt
```
OH GPIO controller bindings

Required properties:
- compatible: "oh,gpio"
- reg: Address and length of the register set for the device
- interrupt-parent: phandle of the parent interrupt controller.
- interrupts : Should be the port interrupt shared by all 32 pins.
- gpio-controller : Marks the device node as a GPIO controller.
- #gpio-cells : Should be two.
  - first cell is the pin number
  - second cell is used to specify optional parameters (unused)
- interrupt-controller: Mark the device node as an interrupt controller.
- #interrupt-cells : Should be 2.
  The first cell is the GPIO number.
  The second cell is used to specify flags:
    bits[3:0] trigger type and level flags:
      1 = rising edge triggered.
      2 = falling edge triggered.
      4 = active high level-sensitive.
      8 = active low level-sensitive.

Example:

gpio0: gpio0 {
	compatible = "oh,gpio";
	reg = <0xe000a000 0x1000>;
	interrupt-parent = <&intc>;
	interrupts = <57>;
	gpio-controller;
	#gpio-cells = <2>;
	interrupt-controller;
	#interrupt-cells = <2>;
};
```
